## CMakeLists.txt
```
cmake_minimum_required(VERSION 3.20.0)
find_package(Zephyr REQUIRED HINTS $ENV{ZEPHYR_BASE})
project(my5340_app)

# Set wasm3 build options to avoid problematic dependencies
set(BUILD_WASI "none" CACHE STRING "WASI implementation" FORCE)
set(BUILD_NATIVE OFF CACHE BOOL "Build with machine-specific optimisations" FORCE)

# Ensure wasm3 is built with the cross-compiler
set(CMAKE_C_COMPILER ${CMAKE_C_COMPILER} CACHE STRING "C compiler" FORCE)
set(CMAKE_CXX_COMPILER ${CMAKE_CXX_COMPILER} CACHE STRING "C++ compiler" FORCE)
set(CMAKE_ASM_COMPILER ${CMAKE_ASM_COMPILER} CACHE STRING "ASM compiler" FORCE)

# Create our app target
target_sources(app PRIVATE
    src/main.c
    src/services/ble_services.c
    src/services/device_info_service.c
    # Re-enabling services with fixed UUID approach
    src/services/control_service.c
    src/services/data_service.c
    src/services/dfu_service.c
    src/services/sprite_service.c
    src/services/wasm_service.c
)

# Include wasm3 headers and our services
target_include_directories(app PRIVATE 
    $ENV{NCS_ROOT}/modules/lib/wasm3/source
    src/services
    src
)

# Build wasm3 sources directly as part of our project
target_sources(app PRIVATE
    $ENV{NCS_ROOT}/modules/lib/wasm3/source/m3_api_libc.c
    $ENV{NCS_ROOT}/modules/lib/wasm3/source/m3_bind.c
    $ENV{NCS_ROOT}/modules/lib/wasm3/source/m3_code.c
    $ENV{NCS_ROOT}/modules/lib/wasm3/source/m3_compile.c
    $ENV{NCS_ROOT}/modules/lib/wasm3/source/m3_core.c
    $ENV{NCS_ROOT}/modules/lib/wasm3/source/m3_env.c
    $ENV{NCS_ROOT}/modules/lib/wasm3/source/m3_exec.c
    $ENV{NCS_ROOT}/modules/lib/wasm3/source/m3_function.c
    $ENV{NCS_ROOT}/modules/lib/wasm3/source/m3_info.c
    $ENV{NCS_ROOT}/modules/lib/wasm3/source/m3_module.c
    $ENV{NCS_ROOT}/modules/lib/wasm3/source/m3_parse.c
)

# Add wasm3-specific compile definitions
target_compile_definitions(app PRIVATE
    d_m3HasTracer
    d_m3HasWASI
    d_m3FixedHeap=65536
    d_m3VerboseErrorMessages=1
    d_m3LogParse=1
    d_m3LogModule=1
)
```

## west.yml
```
manifest:
  version: "0.13"
  remotes:
    - name: ncs
      url-base: https://github.com/nrfconnect/sdk-nrf
  projects:
    - name: nrf
      remote: ncs
      revision: main
      path: ncs
      import: true
```

## prj.conf
```kconfig
CONFIG_PRINTK=y
CONFIG_LOG=y

# Serial console configuration
CONFIG_SERIAL=y
CONFIG_UART_CONSOLE=y

# Bluetooth configuration
CONFIG_BT=y
CONFIG_BT_PERIPHERAL=y
CONFIG_BT_CENTRAL=y
CONFIG_BT_GATT_CLIENT=y
CONFIG_BT_DEVICE_NAME="Dan5340BLE"

# MTU / buffers (host side)
CONFIG_BT_L2CAP_TX_MTU=247
CONFIG_BT_BUF_ACL_RX_SIZE=251
CONFIG_BT_BUF_ACL_TX_SIZE=251

# Optional: more buffers if pushing throughput
CONFIG_BT_L2CAP_TX_BUF_COUNT=10
CONFIG_BT_BUF_ACL_TX_COUNT=10

# Disable network core build to avoid CMake compatibility issues
CONFIG_PM_EXTERNAL_FLASH_MCUBOOT_SECONDARY=n

# Increase main thread stack size for WASM processing
CONFIG_MAIN_STACK_SIZE=8192

# Increase system workqueue stack size to prevent stack overflow in BLE handlers
CONFIG_SYSTEM_WORKQUEUE_STACK_SIZE=16384

# Increase Bluetooth RX stack size if needed
CONFIG_BT_RX_STACK_SIZE=2048
```

## src/main.c
```c
#include <zephyr/kernel.h>
#include <zephyr/sys/printk.h>
#include <zephyr/bluetooth/bluetooth.h>
#include <zephyr/bluetooth/hci.h>
#include <zephyr/bluetooth/conn.h>
#include <zephyr/bluetooth/uuid.h>
#include <zephyr/bluetooth/gatt.h>

/* Include our modular BLE services */
#include "services/ble_services.h"

/**
 * @file main.c
 * @brief Main application for nRF5340 Multi-Service BLE Device
 * 
 * This application demonstrates industry-standard BLE service architecture
 * with proper separation of concerns across multiple service modules.
 */

/* ============================================================================
 * BLE CONNECTION MANAGEMENT
 * ============================================================================ */

static void connected(struct bt_conn *conn, uint8_t err)
{
    if (err) {
        printk("Connection failed (err %u)\n", err);
        return;
    }
    
    char addr[BT_ADDR_LE_STR_LEN];
    bt_addr_le_to_str(bt_conn_get_dst(conn), addr, sizeof(addr));
    
    printk("Connected to %s\n", addr);
    printk("Connection handle: %d\n", bt_conn_index(conn));
    
    /* Notify all services of connection */
    ble_services_connection_event(conn, true);
    
    /* Request MTU exchange for large packet support */
    int mtu_err = ble_services_request_mtu_exchange(conn);
    if (mtu_err) {
        printk("MTU exchange request failed (err %d)\n", mtu_err);
    }
}

static void disconnected(struct bt_conn *conn, uint8_t reason)
{
    char addr[BT_ADDR_LE_STR_LEN];
    bt_addr_le_to_str(bt_conn_get_dst(conn), addr, sizeof(addr));
    
    printk("Disconnected from %s (reason %u)\n", addr, reason);
    
    /* Notify all services of disconnection */
    ble_services_connection_event(conn, false);
}

static struct bt_conn_cb conn_callbacks = {
    .connected = connected,
    .disconnected = disconnected,
};

/* ============================================================================
 * BLE INITIALIZATION
 * ============================================================================ */

static void bt_ready(int err)
{
    if (err) {
        printk("Bluetooth init failed (err %d)\n", err);
        return;
    }

    printk("Bluetooth initialized\n");
    
    /* Initialize all BLE services */
    err = ble_services_init();
    if (err) {
        printk("Failed to initialize BLE services (err %d)\n", err);
        return;
    }

    /* Start advertising */
    err = bt_le_adv_start(BT_LE_ADV_CONN_NAME, NULL, 0, NULL, 0);
    if (err) {
        printk("Advertising failed to start (err %d)\n", err);
        return;
    }

    printk("Advertising successfully started\n");
    printk("Device name: nRF5340-BLE-Multi-Service\n");
    printk("Ready for connections...\n");
}

/* ============================================================================
 * APPLICATION STATUS MONITORING
 * ============================================================================ */

static void print_status_summary(void)
{
    uint8_t device_status = ble_services_get_device_status();
    const char *status_str;
    
    switch (device_status) {
    case 0:
        status_str = "idle";
        break;
    case 1:
        status_str = "connected";
        break;
    case 2:
        status_str = "error";
        break;
    default:
        status_str = "unknown";
        break;
    }
    
    printk("Status: Device=%s, Uptime=%lld seconds\n",
           status_str, k_uptime_get() / 1000);
}

/* ============================================================================
 * MAIN APPLICATION
 * ============================================================================ */

int main(void)
{
    int err;

    /* Print startup banner */
    printk("\n");
    printk("========================================\n");
    printk("nRF5340 Multi-Service BLE Device\n");
    printk("Build: %s %s\n", __DATE__, __TIME__);
    printk("========================================\n");
    printk("Industry-Standard BLE Implementation\n");
    printk("Modular Service Architecture\n");
    printk("========================================\n");

    /* Initialize the Bluetooth subsystem */
    err = bt_enable(bt_ready);
    if (err) {
        printk("Bluetooth init failed (err %d)\n", err);
        return 0;
    }

    /* Register connection callbacks */
    bt_conn_cb_register(&conn_callbacks);

    printk("BLE device initialization complete\n");
    printk("Waiting for connections...\n");

    /* Main application loop */
    while (1) {
        /* Periodic status updates every 30 seconds */
        k_sleep(K_SECONDS(30));
        print_status_summary();
    }

    return 0;
}
```

## src/wamr_wrapper.c
```c
#include "wamr_wrapper.h"
#include <string.h>
#include <stdlib.h>

// For now, we'll use placeholder implementations until we integrate the actual WAMR library
// This allows us to test the build system and gradually add WAMR functionality

int wamr_init(wamr_runtime_t *runtime, const wamr_config_t *config)
{
    if (!runtime || !config) {
        return -1;
    }
    
    // Initialize runtime structure
    memset(runtime, 0, sizeof(wamr_runtime_t));
    
    // For now, just mark as initialized
    // TODO: Call actual WAMR initialization functions
    runtime->is_initialized = true;
    
    printk("WAMR runtime initialized (placeholder)\n");
    printk("  Stack size: %u bytes\n", config->stack_size);
    printk("  Heap size: %u bytes\n", config->heap_size);
    printk("  Max memory pages: %u\n", config->max_memory_pages);
    
    return 0;
}

int wamr_load_module(wamr_runtime_t *runtime, const uint8_t *wasm_binary, size_t size)
{
    if (!runtime || !wasm_binary || size == 0) {
        return -1;
    }
    
    if (!runtime->is_initialized) {
        printk("WAMR runtime not initialized\n");
        return -1;
    }
    
    // For now, just store the binary data
    // TODO: Call actual WAMR module loading functions
    runtime->is_loaded = true;
    
    printk("WAMR module loaded (placeholder): %zu bytes\n", size);
    
    // Print first few bytes for debugging
    printk("First 16 bytes: ");
    for (size_t i = 0; i < 16 && i < size; i++) {
        printk("%02x ", wasm_binary[i]);
    }
    printk("\n");
    
    return 0;
}

int wamr_instantiate_module(wamr_runtime_t *runtime)
{
    if (!runtime) {
        return -1;
    }
    
    if (!runtime->is_loaded) {
        printk("WAMR module not loaded\n");
        return -1;
    }
    
    // For now, just mark as instantiated
    // TODO: Call actual WAMR instantiation functions
    runtime->is_instantiated = true;
    
    printk("WAMR module instantiated (placeholder)\n");
    
    return 0;
}

int wamr_call_function(wamr_runtime_t *runtime, const char *function_name, 
                      const void *args, size_t num_args, void *result)
{
    if (!runtime || !function_name) {
        return -1;
    }
    
    if (!runtime->is_instantiated) {
        printk("WAMR module not instantiated\n");
        return -1;
    }
    
    // For now, just print the function call
    // TODO: Call actual WAMR function execution
    printk("WAMR function call (placeholder): %s\n", function_name);
    printk("  Arguments: %zu\n", num_args);
    
    if (result) {
        // Return a dummy result for testing
        *(int*)result = 42;
    }
    
    return 0;
}

void wamr_cleanup(wamr_runtime_t *runtime)
{
    if (!runtime) {
        return;
    }
    
    // For now, just reset the state
    // TODO: Call actual WAMR cleanup functions
    runtime->is_initialized = false;
    runtime->is_loaded = false;
    runtime->is_instantiated = false;
    
    printk("WAMR runtime cleaned up (placeholder)\n");
}

void wamr_print_error(const char *prefix)
{
    if (prefix) {
        printk("%s: WAMR error (placeholder)\n", prefix);
    } else {
        printk("WAMR error (placeholder)\n");
    }
}

bool wamr_is_initialized(const wamr_runtime_t *runtime)
{
    return runtime && runtime->is_initialized;
}
```

## src/wamr_wrapper.h
```c
#ifndef WAMR_WRAPPER_H
#define WAMR_WRAPPER_H

#include <zephyr/kernel.h>
#include <zephyr/sys/printk.h>
#include <stdint.h>
#include <stdbool.h>

// WAMR runtime handle
typedef struct {
    void *runtime;
    void *module;
    void *module_inst;
    void *exec_env;
    bool is_initialized;
    bool is_loaded;
    bool is_instantiated;
} wamr_runtime_t;

// WAMR configuration
typedef struct {
    uint32_t stack_size;
    uint32_t heap_size;
    uint32_t max_memory_pages;
    bool enable_gc;
    bool enable_simd;
    bool enable_ref_types;
} wamr_config_t;

// Function prototypes
int wamr_init(wamr_runtime_t *runtime, const wamr_config_t *config);
int wamr_load_module(wamr_runtime_t *runtime, const uint8_t *wasm_binary, size_t size);
int wamr_instantiate_module(wamr_runtime_t *runtime);
int wamr_call_function(wamr_runtime_t *runtime, const char *function_name, 
                      const void *args, size_t num_args, void *result);
void wamr_cleanup(wamr_runtime_t *runtime);

// Utility functions
void wamr_print_error(const char *prefix);
bool wamr_is_initialized(const wamr_runtime_t *runtime);

#endif // WAMR_WRAPPER_H
```

## src/wasm3_wrapper.c
```c
#include "wasm3_wrapper.h"
#include <zephyr/kernel.h>
#include <zephyr/sys/printk.h>
#include <string.h>

// Include actual wasm3 headers
#include "m3_core.h"
#include "m3_env.h"
#include "m3_info.h"
#include "m3_api_libc.h"

// wasm3 error constants
#define m3Err_none NULL
#define m3Err_mallocFailed "malloc failed"

int wasm3_init(wasm3_runtime_t* runtime, const wasm3_config_t* config)
{
    if (!runtime || !config) {
        return WASM3_ERROR_INIT_FAILED;
    }

    // Initialize runtime structure
    memset(runtime, 0, sizeof(wasm3_runtime_t));

    // Create M3 environment
    IM3Environment env = m3_NewEnvironment();
    if (!env) {
        printk("wasm3: Failed to create environment\n");
        return WASM3_ERROR_INIT_FAILED;
    }

    // Create M3 runtime
    IM3Runtime m3_runtime = m3_NewRuntime(env, config->stack_size, NULL);
    if (!m3_runtime) {
        printk("wasm3: Failed to create runtime\n");
        m3_FreeEnvironment(env);
        return WASM3_ERROR_INIT_FAILED;
    }

    // Store pointers
    runtime->runtime = m3_runtime;
    runtime->initialized = 1;

    printk("wasm3: Runtime initialized successfully\n");
    return WASM3_SUCCESS;
}

int wasm3_load_module(wasm3_runtime_t* runtime, const uint8_t* wasm_binary, size_t size)
{
    if (!runtime || !runtime->initialized || !wasm_binary || size == 0) {
        return WASM3_ERROR_LOAD_FAILED;
    }

    IM3Runtime m3_runtime = (IM3Runtime)runtime->runtime;
    
    // Get environment from runtime (we need to create a new one since we don't have a module yet)
    IM3Environment env = m3_NewEnvironment();
    if (!env) {
        printk("wasm3: Failed to create environment\n");
        return WASM3_ERROR_LOAD_FAILED;
    }

    // Parse WASM module
    IM3Module module;
    M3Result result = m3_ParseModule(env, &module, wasm_binary, size);
    if (result != m3Err_none) {
        printk("wasm3: Failed to parse WASM module: %s\n", result);
        m3_FreeEnvironment(env);
        return WASM3_ERROR_LOAD_FAILED;
    }

    // Load module into runtime
    result = m3_LoadModule(m3_runtime, module);
    if (result != m3Err_none) {
        printk("wasm3: Failed to load module: %s\n", result);
        m3_FreeModule(module);
        m3_FreeEnvironment(env);
        return WASM3_ERROR_LOAD_FAILED;
    }

    runtime->module = module;
    printk("wasm3: Module loaded successfully\n");
    return WASM3_SUCCESS;
}

int wasm3_compile_module(wasm3_runtime_t* runtime)
{
    if (!runtime || !runtime->initialized || !runtime->module) {
        return WASM3_ERROR_COMPILE_FAILED;
    }

    IM3Module module = (IM3Module)runtime->module;

    // Compile module
    M3Result result = m3_CompileModule(module);
    if (result != m3Err_none) {
        printk("wasm3: Failed to compile module: %s\n", result);
        return WASM3_ERROR_COMPILE_FAILED;
    }

    printk("wasm3: Module compiled successfully\n");
    return WASM3_SUCCESS;
}

int wasm3_call_function(wasm3_runtime_t* runtime, const char* function_name, 
                       const void* args, size_t num_args, int* result)
{
    if (!runtime || !runtime->initialized || !runtime->module || !function_name) {
        return WASM3_ERROR_EXECUTION_FAILED;
    }

    IM3Runtime m3_runtime = (IM3Runtime)runtime->runtime;

    // Find function by name
    IM3Function function;
    M3Result find_result = m3_FindFunction(&function, m3_runtime, function_name);
    if (find_result != m3Err_none) {
        printk("wasm3: Function '%s' not found: %s\n", function_name, find_result);
        return WASM3_ERROR_EXECUTION_FAILED;
    }

    // Call function
    M3Result call_result = m3_CallV(function);
    if (call_result != m3Err_none) {
        printk("wasm3: Function call failed: %s\n", call_result);
        return WASM3_ERROR_EXECUTION_FAILED;
    }

    // Get return value if requested
    if (result) {
        // For now, just return a default value since getting results is complex
        *result = 42;
    }

    printk("wasm3: Function '%s' executed successfully\n", function_name);
    return WASM3_SUCCESS;
}

void wasm3_cleanup(wasm3_runtime_t* runtime)
{
    if (!runtime) {
        return;
    }

    if (runtime->module) {
        m3_FreeModule((IM3Module)runtime->module);
        runtime->module = NULL;
    }

    if (runtime->runtime) {
        m3_FreeRuntime((IM3Runtime)runtime->runtime);
        runtime->runtime = NULL;
    }

    runtime->initialized = 0;
    printk("wasm3: Runtime cleaned up\n");
}
```

## src/wasm3_wrapper.h
```c
#ifndef WASM3_WRAPPER_H
#define WASM3_WRAPPER_H

#include <stdint.h>
#include <stddef.h>

#ifdef __cplusplus
extern "C" {
#endif

// wasm3 runtime structure
typedef struct {
    void* runtime;
    void* module;
    int initialized;
} wasm3_runtime_t;

// wasm3 configuration
typedef struct {
    size_t stack_size;
    size_t heap_size;
    int enable_tracing;
} wasm3_config_t;

// Function return codes
#define WASM3_SUCCESS 0
#define WASM3_ERROR_INIT_FAILED -1
#define WASM3_ERROR_LOAD_FAILED -2
#define WASM3_ERROR_COMPILE_FAILED -3
#define WASM3_ERROR_EXECUTION_FAILED -4

// Initialize wasm3 runtime
int wasm3_init(wasm3_runtime_t* runtime, const wasm3_config_t* config);

// Load WASM module from binary data
int wasm3_load_module(wasm3_runtime_t* runtime, const uint8_t* wasm_binary, size_t size);

// Compile loaded module
int wasm3_compile_module(wasm3_runtime_t* runtime);

// Call function by name
int wasm3_call_function(wasm3_runtime_t* runtime, const char* function_name, 
                       const void* args, size_t num_args, int* result);

// Cleanup
void wasm3_cleanup(wasm3_runtime_t* runtime);

#ifdef __cplusplus
}
#endif

#endif // WASM3_WRAPPER_H
```

## src/wasm_interpreter.c
```c
#include "wasm_interpreter.h"
#include <string.h>

// Simple WASM interpreter implementation
// This is a placeholder for Phase 1 - we'll replace with WAMR later

int wasm_interpreter_init(wasm_interpreter_t *interpreter)
{
    if (!interpreter) {
        return -1;
    }
    
    // Initialize interpreter state
    interpreter->bytecode = NULL;
    interpreter->bytecode_size = 0;
    interpreter->memory = NULL;
    interpreter->memory_size = 0;
    interpreter->is_loaded = false;
    interpreter->is_running = false;
    
    printk("WASM interpreter initialized\n");
    return 0;
}

int wasm_interpreter_load_bytecode(wasm_interpreter_t *interpreter, 
                                  const uint8_t *bytecode, 
                                  size_t size)
{
    if (!interpreter || !bytecode || size == 0) {
        return -1;
    }
    
    // For Phase 1, we'll just store a reference
    // In Phase 2, we'll actually parse and validate WASM bytecode
    interpreter->bytecode = (uint8_t *)bytecode;
    interpreter->bytecode_size = size;
    interpreter->is_loaded = true;
    
    printk("WASM bytecode loaded: %d bytes\n", size);
    return 0;
}

int wasm_interpreter_execute(wasm_interpreter_t *interpreter)
{
    if (!interpreter || !interpreter->is_loaded) {
        return -1;
    }
    
    interpreter->is_running = true;
    
    // For Phase 1, we'll just print some test output
    // In Phase 2, we'll actually execute the WASM bytecode
    printk("=== WASM Execution Started ===\n");
    printk("Bytecode size: %d bytes\n", interpreter->bytecode_size);
    
    // Print first few bytes as hex (for debugging)
    printk("First 16 bytes: ");
    for (int i = 0; i < 16 && i < interpreter->bytecode_size; i++) {
        printk("%02x ", interpreter->bytecode[i]);
    }
    printk("\n");
    
    printk("Result: Hello from WASM!\n");
    printk("=== WASM Execution Complete ===\n");
    
    interpreter->is_running = false;
    return 0;
}

void wasm_interpreter_cleanup(wasm_interpreter_t *interpreter)
{
    if (!interpreter) {
        return;
    }
    
    // Clean up resources
    interpreter->bytecode = NULL;
    interpreter->bytecode_size = 0;
    interpreter->memory = NULL;
    interpreter->memory_size = 0;
    interpreter->is_loaded = false;
    interpreter->is_running = false;
    
    printk("WASM interpreter cleaned up\n");
}

// Simple test function that prints to serial
void wasm_test_function(void)
{
    printk("=== WASM Test Function Called ===\n");
    printk("This is a placeholder for actual WASM execution\n");
    printk("In Phase 2, this will execute real WASM bytecode\n");
    printk("=== Test Function Complete ===\n");
}
```

## src/wasm_interpreter.h
```c
#ifndef WASM_INTERPRETER_H
#define WASM_INTERPRETER_H

#include <zephyr/kernel.h>
#include <zephyr/sys/printk.h>

// Simple WASM interpreter structure
typedef struct {
    uint8_t *bytecode;
    size_t bytecode_size;
    uint8_t *memory;
    size_t memory_size;
    bool is_loaded;
    bool is_running;
} wasm_interpreter_t;

// Function prototypes
int wasm_interpreter_init(wasm_interpreter_t *interpreter);
int wasm_interpreter_load_bytecode(wasm_interpreter_t *interpreter, 
                                  const uint8_t *bytecode, 
                                  size_t size);
int wasm_interpreter_execute(wasm_interpreter_t *interpreter);
void wasm_interpreter_cleanup(wasm_interpreter_t *interpreter);

// Simple test function that prints to serial
void wasm_test_function(void);

#endif // WASM_INTERPRETER_H
```

## src/wasm_test_module.h
```c
#ifndef WASM_TEST_MODULE_H
#define WASM_TEST_MODULE_H

// Simple test WASM bytecode for Phase 1
// This is a minimal WASM module that just returns a constant
// In Phase 2, we'll load real WASM bytecode via BLE

// Minimal WASM module (version 1, empty sections)
static const uint8_t test_wasm_module[] = {
    0x00, 0x61, 0x73, 0x6d,  // Magic number: "\0asm"
    0x01, 0x00, 0x00, 0x00,  // Version: 1
    0x00,                      // Custom section count
    0x00,                      // Type section count
    0x00,                      // Import section count
    0x00,                      // Function section count
    0x00,                      // Table section count
    0x00,                      // Memory section count
    0x00,                      // Global section count
    0x00,                      // Export section count
    0x00,                      // Start section count
    0x00,                      // Element section count
    0x00,                      // Code section count
    0x00                       // Data section count
};

#define TEST_WASM_MODULE_SIZE sizeof(test_wasm_module)

#endif // WASM_TEST_MODULE_H
```
